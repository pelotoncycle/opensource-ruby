## kernel/mediatek/mt8173/3.10/drivers/misc/mediatek/als/Kconfig
```kconfig
config CUSTOM_KERNEL_ALSPS
	bool "CUSTOM_KERNEL_ALSPS"
	help
	  ALSPS sensor driverto detect ambint light and the object is close
	  or far awary from device
config CUSTOM_KERNEL_ALS
	bool "CUSTOM_KERNEL_ALS"
	help
	  ALS sensor driverto detect ambint light and the object is close
	  or far awary from device
config MTK_AUTO_DETECT_ALSPS
	bool "MTK_AUTO_DETECT_ALSPS"
	help
	  This feature Option is used for projects which using more than one
	  ALSPS sensors, more than one ALSPS drivers can be builded in to
	  project and be auto detected by setting this option to yes

source "drivers/misc/mediatek/als/EPL6804/Kconfig"
```

## kernel/mediatek/mt8173/3.10/drivers/misc/mediatek/inoco_apple_mfi/Kconfig
```kconfig
config INOCO_APPLE_MFI
	tristate "Innocomm Apple MFi driver"
	depends on I2C
	default n
	---help---
	  Innocomm Apple MFI driver based on I2C.
	  This is a driver to provides I2C access to Apple MFi devices 

	  To compile this driver as a module, choose m here. The module will
	  be called inoco_apple_mfi.
	  Say N if unsure.
```

## kernel/mediatek/mt8173/3.10/sound/soc/mediatek/mt8173/Kconfig
```kconfig
choice
	prompt "MT8173 ASOC platform"

config SND_SOC_MT8173_GENERIC
	bool "MT8173 GENERIC"
	help
	  Say Y if you want to use the default
	  Mediatek SoC Audio interfaces for MT8173.
	  It is the generic solution.

endchoice
```
